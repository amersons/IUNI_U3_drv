## gionee/alps_drv/kernel/drivers/input/touchscreen/synaptics_dsx/Kconfig
```kconfig
#
# Synaptics DSX touchscreen driver configuration
#
menuconfig GN_TOUCHSCREEN_SYNAPTICS_DSX
	bool "Synaptics DSX touchscreen"
	default y
	help
	  Say Y here if you have a Synaptics DSX touchscreen connected
	  to your system.

	  If unsure, say N.

if GN_TOUCHSCREEN_SYNAPTICS_DSX

choice
	default GN_TOUCHSCREEN_SYNAPTICS_DSX_I2C
	prompt "Synaptics DSX bus interface"
config GN_TOUCHSCREEN_SYNAPTICS_DSX_I2C
	bool "RMI over I2C"
	depends on I2C
config GN_TOUCHSCREEN_SYNAPTICS_DSX_SPI
	bool "RMI over SPI"
	depends on SPI_MASTER
config GN_TOUCHSCREEN_SYNAPTICS_DSX_RMI_HID_I2C
	bool "HID over I2C"
	depends on I2C
endchoice

config GN_TOUCHSCREEN_SYNAPTICS_DSX_CORE
	tristate "Synaptics DSX core driver module"
	depends on I2C || SPI_MASTER
	help
	  Say Y here to enable basic touch reporting functionalities.

	  If unsure, say N.

	  To compile this driver as a module, choose M here: the
	  module will be called synaptics_dsx_core.

config GN_TOUCHSCREEN_SYNAPTICS_DSX_RMI_DEV
	tristate "Synaptics DSX RMI device module"
	depends on GN_TOUCHSCREEN_SYNAPTICS_DSX_CORE
	help
	  Say Y here to enable support for direct RMI register access.

	  If unsure, say N.

	  To compile this driver as a module, choose M here: the
	  module will be called synaptics_dsx_rmi_dev.

config GN_TOUCHSCREEN_SYNAPTICS_DSX_FW_UPDATE
	tristate "Synaptics DSX firmware update module"
	depends on GN_TOUCHSCREEN_SYNAPTICS_DSX_CORE
	help
	  Say Y here to enable support for doing firmware update.

	  If unsure, say N.

	  To compile this driver as a module, choose M here: the
	  module will be called synaptics_dsx_fw_update.

config GN_TOUCHSCREEN_SYNAPTICS_DSX_ACTIVE_PEN
	tristate "Synaptics DSX active pen module"
	depends on GN_TOUCHSCREEN_SYNAPTICS_DSX_CORE
	help
	  Say Y here to enable support for active pen functionalities.

	  If unsure, say N.

	  To compile this driver as a module, choose M here: the
	  module will be called synaptics_dsx_active_pen.

config GN_TOUCHSCREEN_SYNAPTICS_DSX_PROXIMITY
	tristate "Synaptics DSX proximity module"
	depends on GN_TOUCHSCREEN_SYNAPTICS_DSX_CORE
	help
	  Say Y here to enable support for proximity functionalities.

	  If unsure, say N.

	  To compile this driver as a module, choose M here: the
	  module will be called synaptics_dsx_proximity.

config GN_TOUCHSCREEN_SYNAPTICS_DSX_TEST_REPORTING
	tristate "Synaptics DSX test reporting module"
	depends on GN_TOUCHSCREEN_SYNAPTICS_DSX_CORE
	help
	  Say Y here to enable support for retrieving production test reports.

	  If unsure, say N.

	  To compile this driver as a module, choose M here: the
	  module will be called synaptics_dsx_test_reporting.

config GN_TOUCHSCREEN_SYNAPTICS_DSX_DEBUG
	tristate "Synaptics DSX debug module"
	depends on GN_TOUCHSCREEN_SYNAPTICS_DSX_CORE
	help
	  Say Y here to enable support for firmware debug functionalities.

	  If unsure, say N.

	  To compile this driver as a module, choose M here: the
	  module will be called synaptics_dsx_debug.

endif
```
