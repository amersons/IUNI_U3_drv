/* Copyright (c) 2013, The Linux Foundation. All rights reserved.
 *
 * This program is free software; you can redistribute it and/or modify
 * it under the terms of the GNU General Public License version 2 and
 * only version 2 as published by the Free Software Foundation.
 *
 * This program is distributed in the hope that it will be useful,
 * but WITHOUT ANY WARRANTY; without even the implied warranty of
 * MERCHANTABILITY or FITNESS FOR A PARTICULAR PURPOSE.  See the
 * GNU General Public License for more details.
 */

qcom,lg-ds-2900mah {
	qcom,fcc-mah = <2900>;
	qcom,default-rbatt-mohm = <161>;
	qcom,rbatt-capacitive-mohm = <50>;
	qcom,flat-ocv-threshold-uv = <3700000>;
	qcom,max-voltage-uv = <4350000>;
	qcom,v-cutoff-uv = <3400000>;
	qcom,chg-term-ua = <100000>;
	qcom,batt-id-kohm = <100>;

	qcom,fcc-temp-lut {
		qcom,lut-col-legend = <(-20) 0 25 40 60>;
		qcom,lut-data = <2944 2959 2947 2947 2935>;
	};

	qcom,pc-temp-ocv-lut {
		qcom,lut-col-legend = <(-20) 0 25 40 60>;
		qcom,lut-row-legend = <100 95 90 85 80>,
				<75 70 65 60 55>,
				<50 45 40 35 30>,
				<25 20 16 13 11>,
				<10 9 8 7 6>,
				<5 4 3 2 1>,
				<0>;
		qcom,lut-data = <4340 4337 4335 4328 4324>,
				<4235 4267 4270 4266 4261>,
				<4164 4206 4212 4209 4204>,
				<4106 4149 4156 4153 4149>,
				<4055 4095 4103 4100 4096>,
				<3967 4045 4054 4050 4046>,
				<3925 3990 4004 4004 4000>,
				<3883 3938 3963 3962 3959>,
				<3849 3894 3920 3922 3919>,
				<3827 3856 3870 3874 3870>,
				<3809 3826 3837 3837 3836>,
				<3793 3802 3813 3813 3812>,
				<3777 3786 3794 3794 3792>,
				<3762 3775 3778 3777 3776>,
				<3746 3764 3767 3761 3756>,
				<3730 3749 3754 3742 3728>,
				<3711 3724 3729 3718 3704>,
				<3693 3699 3698 3687 3674>,
				<3675 3683 3678 3668 3656>,
				<3662 3674 3673 3664 3653>,
				<3654 3669 3671 3662 3651>,
				<3644 3664 3668 3659 3648>,
				<3633 3657 3664 3656 3644>,
				<3620 3647 3657 3648 3635>,
				<3601 3629 3640 3629 3609>,
				<3575 3601 3606 3592 3568>,
				<3538 3560 3555 3541 3516>,
				<3483 3501 3490 3476 3449>,
				<3402 3418 3403 3390 3358>,
				<3280 3287 3276 3261 3221>,
				<3000 3000 3000 3000 3000>;
	};

	qcom,rbatt-sf-lut {
		qcom,lut-col-legend = <(-20) 0 25 40 60>;
		qcom,lut-row-legend = <100 95 90 85 80>,
				<75 70 65 60 55>,
				<50 45 40 35 30>,
				<25 20 16 13 11>,
				<10 9 8 7 6>,
				<5 4 3 2 1>,
				<0>;
		qcom,lut-data = <1018 224 100 80 75>,
				<1016 224 100 80 75>,
				<944 227 103 82 76>,
				<906 234 106 84 77>,
				<891 239 112 86 80>,
				<818 258 116 89 81>,
				<818 250 121 93 83>,
				<811 234 126 96 85>,
				<814 229 126 99 87>,
				<833 223 108 90 81>,
				<860 223 102 82 77>,
				<900 227 104 85 79>,
				<947 239 107 88 82>,
				<998 259 111 90 84>,
				<1053 288 113 88 82>,
				<1114 323 116 85 78>,
				<1190 360 115 85 78>,
				<1272 396 115 85 78>,
				<1349 435 116 85 78>,
				<1383 450 122 88 80>,
				<1534 474 126 90 81>,
				<1738 503 131 91 81>,
				<2007 537 137 93 81>,
				<2370 575 143 94 81>,
				<2880 617 146 92 80>,
				<3629 670 145 92 82>,
				<4747 730 150 95 85>,
				<6466 820 163 100 87>,
				<9162 991 185 107 92>,
				<13562 1431 234 127 127>,
				<13251 2627 2442 2757 578>;
	};
};
