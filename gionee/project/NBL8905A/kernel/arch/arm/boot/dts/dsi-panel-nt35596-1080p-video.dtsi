/* Copyright (c) 2013, The Linux Foundation. All rights reserved.
 *
 * This program is free software; you can redistribute it and/or modify
 * it under the terms of the GNU General Public License version 2 and
 * only version 2 as published by the Free Software Foundation.
 *
 * This program is distributed in the hope that it will be useful,
 * but WITHOUT ANY WARRANTY; without even the implied warranty of
 * MERCHANTABILITY or FITNESS FOR A PARTICULAR PURPOSE.  See the
 * GNU General Public License for more details.
 */

/*---------------------------------------------------------------------------
 * This file is autogenerated file using gcdb parser. Please do not edit it.
 * Update input XML file to add a new entry or update variable in this file
 * VERSION = "1.0"
 *---------------------------------------------------------------------------*/
&mdss_mdp {
	dsi_nt35596_1080_vid: qcom,mdss_dsi_nt35596_1080p_video {
		qcom,mdss-dsi-panel-name = "nt35596 1080p video mode dsi panel";
		qcom,mdss-dsi-panel-controller = <&mdss_dsi0>;
		qcom,mdss-dsi-panel-type = "dsi_video_mode";
		qcom,mdss-dsi-panel-destination = "display_1";
		qcom,mdss-dsi-panel-framerate = <60>;
		qcom,mdss-dsi-virtual-channel-id = <0>;
		qcom,mdss-dsi-stream = <0>;
		qcom,mdss-dsi-panel-width = <1080>;
		qcom,mdss-dsi-panel-height = <1920>;
		qcom,mdss-dsi-h-front-porch = <100>;
		qcom,mdss-dsi-h-back-porch = <100>;
		qcom,mdss-dsi-h-pulse-width = <20>;
		qcom,mdss-dsi-h-sync-skew = <0>;
		qcom,mdss-dsi-v-back-porch = <18>;
		qcom,mdss-dsi-v-front-porch = <8>;
		qcom,mdss-dsi-v-pulse-width = <2>;
		qcom,mdss-dsi-h-left-border = <0>;
		qcom,mdss-dsi-h-right-border = <0>;
		qcom,mdss-dsi-v-top-border = <0>;
		qcom,mdss-dsi-v-bottom-border = <0>;
		qcom,mdss-dsi-bpp = <24>;
		qcom,mdss-dsi-underflow-color = <0xff>;
		qcom,mdss-dsi-border-color = <0>;
		qcom,mdss-dsi-on-command = [
29 01 00 00 00 00 02 FF 01
29 01 00 00 00 00 02 FB 01
29 01 00 00 00 00 02 00 01
29 01 00 00 00 00 02 01 55
29 01 00 00 00 00 02 02 40
29 01 00 00 00 00 02 05 50
29 01 00 00 00 00 02 06 4A
29 01 00 00 00 00 02 07 23
29 01 00 00 00 00 02 08 0C
29 01 00 00 00 00 02 0B 7D
29 01 00 00 00 00 02 0C 7D
29 01 00 00 00 00 02 0E B5
29 01 00 00 00 00 02 0F A9
29 01 00 00 00 00 02 11 0F
29 01 00 00 00 00 02 13 01
29 01 00 00 00 00 02 14 4A
29 01 00 00 00 00 02 15 0F
29 01 00 00 00 00 02 16 0F
29 01 00 00 00 00 02 18 00
29 01 00 00 00 00 02 19 77
29 01 00 00 00 00 02 1A 55
29 01 00 00 00 00 02 1B 1B
29 01 00 00 00 00 02 1C F7
29 01 00 00 00 00 02 1D 00
29 01 00 00 00 00 02 1E 00
29 01 00 00 00 00 02 1F 00
29 01 00 00 00 00 02 35 00
29 01 00 00 00 00 02 58 82
29 01 00 00 00 00 02 59 00
29 01 00 00 00 00 02 5A 02
29 01 00 00 00 00 02 5B 00
29 01 00 00 00 00 02 5C 82
29 01 00 00 00 00 02 5D 80
29 01 00 00 00 00 02 5E 02
29 01 00 00 00 00 02 5F 00
29 01 00 00 00 00 02 60 0F
29 01 00 00 00 00 02 66 01
29 01 00 00 00 00 02 6D 22
29 01 00 00 00 00 02 72 31
29 01 00 00 00 00 02 FF 05
29 01 00 00 00 00 02 FB 01
29 01 00 00 00 00 02 A6 04
29 01 00 00 00 00 02 00 01
29 01 00 00 00 00 02 01 0B
29 01 00 00 00 00 02 02 0C
29 01 00 00 00 00 02 03 09
29 01 00 00 00 00 02 04 0A
29 01 00 00 00 00 02 05 00
29 01 00 00 00 00 02 06 0F
29 01 00 00 00 00 02 07 10
29 01 00 00 00 00 02 08 00
29 01 00 00 00 00 02 09 00
29 01 00 00 00 00 02 0A 00
29 01 00 00 00 00 02 0B 00
29 01 00 00 00 00 02 0C 00
29 01 00 00 00 00 02 0D 13
29 01 00 00 00 00 02 0E 15
29 01 00 00 00 00 02 0F 17
29 01 00 00 00 00 02 10 01
29 01 00 00 00 00 02 11 0B
29 01 00 00 00 00 02 12 0C
29 01 00 00 00 00 02 13 09
29 01 00 00 00 00 02 14 0A
29 01 00 00 00 00 02 15 00
29 01 00 00 00 00 02 16 0F
29 01 00 00 00 00 02 17 10
29 01 00 00 00 00 02 18 00
29 01 00 00 00 00 02 19 00
29 01 00 00 00 00 02 1A 00
29 01 00 00 00 00 02 1B 00
29 01 00 00 00 00 02 1C 00
29 01 00 00 00 00 02 1D 13
29 01 00 00 00 00 02 1E 15
29 01 00 00 00 00 02 1F 17
29 01 00 00 00 00 02 20 00
29 01 00 00 00 00 02 21 03
29 01 00 00 00 00 02 22 01
29 01 00 00 00 00 02 23 40
29 01 00 00 00 00 02 24 40
29 01 00 00 00 00 02 25 ED
29 01 00 00 00 00 02 29 58
29 01 00 00 00 00 02 2A 12
29 01 00 00 00 00 02 2B 01
29 01 00 00 00 00 02 4B 06
29 01 00 00 00 00 02 4C 11
29 01 00 00 00 00 02 4D 20
29 01 00 00 00 00 02 4E 02
29 01 00 00 00 00 02 4F 02
29 01 00 00 00 00 02 50 20
29 01 00 00 00 00 02 51 61
29 01 00 00 00 00 02 52 01
29 01 00 00 00 00 02 53 63
29 01 00 00 00 00 02 54 75
29 01 00 00 00 00 02 55 ED
29 01 00 00 00 00 02 5B 00
29 01 00 00 00 00 02 5C 00
29 01 00 00 00 00 02 5D 00
29 01 00 00 00 00 02 5E 00
29 01 00 00 00 00 02 5F 15
29 01 00 00 00 00 02 60 75
29 01 00 00 00 00 02 61 00
29 01 00 00 00 00 02 62 00
29 01 00 00 00 00 02 63 00
29 01 00 00 00 00 02 64 00
29 01 00 00 00 00 02 65 00
29 01 00 00 00 00 02 66 00
29 01 00 00 00 00 02 67 00
29 01 00 00 00 00 02 68 04
29 01 00 00 00 00 02 69 00
29 01 00 00 00 00 02 6A 00
29 01 00 00 00 00 02 6C 40
29 01 00 00 00 00 02 75 01
29 01 00 00 00 00 02 76 01
29 01 00 00 00 00 02 7A 80
29 01 00 00 00 00 02 7B A3
29 01 00 00 00 00 02 7C D8
29 01 00 00 00 00 02 7D 60
29 01 00 00 00 00 02 7F 15
29 01 00 00 00 00 02 81 0C
29 01 00 00 00 00 02 8A 33
29 01 00 00 00 00 02 93 06
29 01 00 00 00 00 02 94 30
29 01 00 00 00 00 02 9B 0F
29 01 00 00 00 00 02 85 05
29 01 00 00 00 00 02 FF EE
29 01 00 00 00 00 02 FB 01
29 01 00 00 00 00 02 7C 31
29 01 00 00 00 00 02 FF FF
29 01 00 00 00 00 02 FB 01
29 01 00 00 00 00 02 4F 03
29 01 00 00 00 00 02 FF 04
29 01 00 00 00 00 02 FB 01
29 01 00 00 00 00 02 08 0F
29 01 00 00 00 00 02 FF 00
29 01 00 00 00 00 02 FF 01
29 01 00 00 00 00 02 FB 01
29 01 00 00 00 00 02 75 00
29 01 00 00 00 00 02 76 00
29 01 00 00 00 00 02 77 00
29 01 00 00 00 00 02 78 23
29 01 00 00 00 00 02 79 00
29 01 00 00 00 00 02 7A 4F
29 01 00 00 00 00 02 7B 00
29 01 00 00 00 00 02 7C 6F
29 01 00 00 00 00 02 7D 00
29 01 00 00 00 00 02 7E 88
29 01 00 00 00 00 02 7F 00
29 01 00 00 00 00 02 80 9D
29 01 00 00 00 00 02 81 00
29 01 00 00 00 00 02 82 B0
29 01 00 00 00 00 02 83 00
29 01 00 00 00 00 02 84 C0
29 01 00 00 00 00 02 85 00
29 01 00 00 00 00 02 86 D0
29 01 00 00 00 00 02 87 01
29 01 00 00 00 00 02 88 02
29 01 00 00 00 00 02 89 01
29 01 00 00 00 00 02 8A 2A
29 01 00 00 00 00 02 8B 01
29 01 00 00 00 00 02 8C 69
29 01 00 00 00 00 02 8D 01
29 01 00 00 00 00 02 8E 9A
29 01 00 00 00 00 02 8F 01
29 01 00 00 00 00 02 90 E6
29 01 00 00 00 00 02 91 02
29 01 00 00 00 00 02 92 21
29 01 00 00 00 00 02 93 02
29 01 00 00 00 00 02 94 23
29 01 00 00 00 00 02 95 02
29 01 00 00 00 00 02 96 59
29 01 00 00 00 00 02 97 02
29 01 00 00 00 00 02 98 97
29 01 00 00 00 00 02 99 02
29 01 00 00 00 00 02 9A C0
29 01 00 00 00 00 02 9B 02
29 01 00 00 00 00 02 9C F9
29 01 00 00 00 00 02 9D 03
29 01 00 00 00 00 02 9E 1D
29 01 00 00 00 00 02 9F 03
29 01 00 00 00 00 02 A0 4C
29 01 00 00 00 00 02 A2 03
29 01 00 00 00 00 02 A3 59
29 01 00 00 00 00 02 A4 03
29 01 00 00 00 00 02 A5 67
29 01 00 00 00 00 02 A6 03
29 01 00 00 00 00 02 A7 76
29 01 00 00 00 00 02 A9 03
29 01 00 00 00 00 02 AA 87
29 01 00 00 00 00 02 AB 03
29 01 00 00 00 00 02 AC 9A
29 01 00 00 00 00 02 AD 03
29 01 00 00 00 00 02 AE B0
29 01 00 00 00 00 02 AF 03
29 01 00 00 00 00 02 B0 D0
29 01 00 00 00 00 02 B1 03
29 01 00 00 00 00 02 B2 FE
29 01 00 00 00 00 02 B3 00
29 01 00 00 00 00 02 B4 00
29 01 00 00 00 00 02 B5 00
29 01 00 00 00 00 02 B6 23
29 01 00 00 00 00 02 B7 00
29 01 00 00 00 00 02 B8 4F
29 01 00 00 00 00 02 B9 00
29 01 00 00 00 00 02 BA 6F
29 01 00 00 00 00 02 BB 00
29 01 00 00 00 00 02 BC 88
29 01 00 00 00 00 02 BD 00
29 01 00 00 00 00 02 BE 9D
29 01 00 00 00 00 02 BF 00
29 01 00 00 00 00 02 C0 B0
29 01 00 00 00 00 02 C1 00
29 01 00 00 00 00 02 C2 C0
29 01 00 00 00 00 02 C3 00
29 01 00 00 00 00 02 C4 D0
29 01 00 00 00 00 02 C5 01
29 01 00 00 00 00 02 C6 02
29 01 00 00 00 00 02 C7 01
29 01 00 00 00 00 02 C8 2A
29 01 00 00 00 00 02 C9 01
29 01 00 00 00 00 02 CA 69
29 01 00 00 00 00 02 CB 01
29 01 00 00 00 00 02 CC 9A
29 01 00 00 00 00 02 CD 01
29 01 00 00 00 00 02 CE E6
29 01 00 00 00 00 02 CF 02
29 01 00 00 00 00 02 D0 21
29 01 00 00 00 00 02 D1 02
29 01 00 00 00 00 02 D2 23
29 01 00 00 00 00 02 D3 02
29 01 00 00 00 00 02 D4 59
29 01 00 00 00 00 02 D5 02
29 01 00 00 00 00 02 D6 97
29 01 00 00 00 00 02 D7 02
29 01 00 00 00 00 02 D8 C0
29 01 00 00 00 00 02 D9 02
29 01 00 00 00 00 02 DA F9
29 01 00 00 00 00 02 DB 03
29 01 00 00 00 00 02 DC 1D
29 01 00 00 00 00 02 DD 03
29 01 00 00 00 00 02 DE 4C
29 01 00 00 00 00 02 DF 03
29 01 00 00 00 00 02 E0 59
29 01 00 00 00 00 02 E1 03
29 01 00 00 00 00 02 E2 67
29 01 00 00 00 00 02 E3 03
29 01 00 00 00 00 02 E4 76
29 01 00 00 00 00 02 E5 03
29 01 00 00 00 00 02 E6 87
29 01 00 00 00 00 02 E7 03
29 01 00 00 00 00 02 E8 9A
29 01 00 00 00 00 02 E9 03
29 01 00 00 00 00 02 EA B0
29 01 00 00 00 00 02 EB 03
29 01 00 00 00 00 02 EC D0
29 01 00 00 00 00 02 ED 03
29 01 00 00 00 00 02 EE FE
29 01 00 00 00 00 02 EF 00
29 01 00 00 00 00 02 F0 00
29 01 00 00 00 00 02 F1 00
29 01 00 00 00 00 02 F2 23
29 01 00 00 00 00 02 F3 00
29 01 00 00 00 00 02 F4 4F
29 01 00 00 00 00 02 F5 00
29 01 00 00 00 00 02 F6 6F
29 01 00 00 00 00 02 F7 00
29 01 00 00 00 00 02 F8 88
29 01 00 00 00 00 02 F9 00
29 01 00 00 00 00 02 FA 9D
29 01 00 00 00 00 02 FF 02
29 01 00 00 00 00 02 FB 01
29 01 00 00 00 00 02 00 00
29 01 00 00 00 00 02 01 B0
29 01 00 00 00 00 02 02 00
29 01 00 00 00 00 02 03 C0
29 01 00 00 00 00 02 04 00
29 01 00 00 00 00 02 05 D0
29 01 00 00 00 00 02 06 01
29 01 00 00 00 00 02 07 02
29 01 00 00 00 00 02 08 01
29 01 00 00 00 00 02 09 2A
29 01 00 00 00 00 02 0A 01
29 01 00 00 00 00 02 0B 69
29 01 00 00 00 00 02 0C 01
29 01 00 00 00 00 02 0D 9A
29 01 00 00 00 00 02 0E 01
29 01 00 00 00 00 02 0F E6
29 01 00 00 00 00 02 10 02
29 01 00 00 00 00 02 11 21
29 01 00 00 00 00 02 12 02
29 01 00 00 00 00 02 13 23
29 01 00 00 00 00 02 14 02
29 01 00 00 00 00 02 15 59
29 01 00 00 00 00 02 16 02
29 01 00 00 00 00 02 17 97
29 01 00 00 00 00 02 18 02
29 01 00 00 00 00 02 19 C0
29 01 00 00 00 00 02 1A 02
29 01 00 00 00 00 02 1B F9
29 01 00 00 00 00 02 1C 03
29 01 00 00 00 00 02 1D 1D
29 01 00 00 00 00 02 1E 03
29 01 00 00 00 00 02 1F 4C
29 01 00 00 00 00 02 20 03
29 01 00 00 00 00 02 21 59
29 01 00 00 00 00 02 22 03
29 01 00 00 00 00 02 23 67
29 01 00 00 00 00 02 24 03
29 01 00 00 00 00 02 25 76
29 01 00 00 00 00 02 26 03
29 01 00 00 00 00 02 27 87
29 01 00 00 00 00 02 28 03
29 01 00 00 00 00 02 29 9A
29 01 00 00 00 00 02 2A 03
29 01 00 00 00 00 02 2B B0
29 01 00 00 00 00 02 2D 03
29 01 00 00 00 00 02 2F D0
29 01 00 00 00 00 02 30 03
29 01 00 00 00 00 02 31 FE
29 01 00 00 00 00 02 32 00
29 01 00 00 00 00 02 33 00
29 01 00 00 00 00 02 34 00
29 01 00 00 00 00 02 35 23
29 01 00 00 00 00 02 36 00
29 01 00 00 00 00 02 37 4F
29 01 00 00 00 00 02 38 00
29 01 00 00 00 00 02 39 6F
29 01 00 00 00 00 02 3A 00
29 01 00 00 00 00 02 3B 88
29 01 00 00 00 00 02 3D 00
29 01 00 00 00 00 02 3F 9D
29 01 00 00 00 00 02 40 00
29 01 00 00 00 00 02 41 B0
29 01 00 00 00 00 02 42 00
29 01 00 00 00 00 02 43 C0
29 01 00 00 00 00 02 44 00
29 01 00 00 00 00 02 45 D0
29 01 00 00 00 00 02 46 01
29 01 00 00 00 00 02 47 02
29 01 00 00 00 00 02 48 01
29 01 00 00 00 00 02 49 2A
29 01 00 00 00 00 02 4A 01
29 01 00 00 00 00 02 4B 69
29 01 00 00 00 00 02 4C 01
29 01 00 00 00 00 02 4D 9A
29 01 00 00 00 00 02 4E 01
29 01 00 00 00 00 02 4F E6
29 01 00 00 00 00 02 50 02
29 01 00 00 00 00 02 51 21
29 01 00 00 00 00 02 52 02
29 01 00 00 00 00 02 53 23
29 01 00 00 00 00 02 54 02
29 01 00 00 00 00 02 55 59
29 01 00 00 00 00 02 56 02
29 01 00 00 00 00 02 58 97
29 01 00 00 00 00 02 59 02
29 01 00 00 00 00 02 5A C0
29 01 00 00 00 00 02 5B 02
29 01 00 00 00 00 02 5C F9
29 01 00 00 00 00 02 5D 03
29 01 00 00 00 00 02 5E 1D
29 01 00 00 00 00 02 5F 03
29 01 00 00 00 00 02 60 4C
29 01 00 00 00 00 02 61 03
29 01 00 00 00 00 02 62 59
29 01 00 00 00 00 02 63 03
29 01 00 00 00 00 02 64 67
29 01 00 00 00 00 02 65 03
29 01 00 00 00 00 02 66 76
29 01 00 00 00 00 02 67 03
29 01 00 00 00 00 02 68 87
29 01 00 00 00 00 02 69 03
29 01 00 00 00 00 02 6A 9A
29 01 00 00 00 00 02 6B 03
29 01 00 00 00 00 02 6C B0
29 01 00 00 00 00 02 6D 03
29 01 00 00 00 00 02 6E D0
29 01 00 00 00 00 02 6F 03
29 01 00 00 00 00 02 70 FE
29 01 00 00 00 00 02 71 00
29 01 00 00 00 00 02 72 00
29 01 00 00 00 00 02 73 00
29 01 00 00 00 00 02 74 23
29 01 00 00 00 00 02 75 00
29 01 00 00 00 00 02 76 4F
29 01 00 00 00 00 02 77 00
29 01 00 00 00 00 02 78 6F
29 01 00 00 00 00 02 79 00
29 01 00 00 00 00 02 7A 88
29 01 00 00 00 00 02 7B 00
29 01 00 00 00 00 02 7C 9D
29 01 00 00 00 00 02 7D 00
29 01 00 00 00 00 02 7E B0
29 01 00 00 00 00 02 7F 00
29 01 00 00 00 00 02 80 C0
29 01 00 00 00 00 02 81 00
29 01 00 00 00 00 02 82 D0
29 01 00 00 00 00 02 83 01
29 01 00 00 00 00 02 84 02
29 01 00 00 00 00 02 85 01
29 01 00 00 00 00 02 86 2A
29 01 00 00 00 00 02 87 01
29 01 00 00 00 00 02 88 69
29 01 00 00 00 00 02 89 01
29 01 00 00 00 00 02 8A 9A
29 01 00 00 00 00 02 8B 01
29 01 00 00 00 00 02 8C E6
29 01 00 00 00 00 02 8D 02
29 01 00 00 00 00 02 8E 21
29 01 00 00 00 00 02 8F 02
29 01 00 00 00 00 02 90 23
29 01 00 00 00 00 02 91 02
29 01 00 00 00 00 02 92 59
29 01 00 00 00 00 02 93 02
29 01 00 00 00 00 02 94 97
29 01 00 00 00 00 02 95 02
29 01 00 00 00 00 02 96 C0
29 01 00 00 00 00 02 97 02
29 01 00 00 00 00 02 98 F9
29 01 00 00 00 00 02 99 03
29 01 00 00 00 00 02 9A 1D
29 01 00 00 00 00 02 9B 03
29 01 00 00 00 00 02 9C 4C
29 01 00 00 00 00 02 9D 03
29 01 00 00 00 00 02 9E 59
29 01 00 00 00 00 02 9F 03
29 01 00 00 00 00 02 A0 67
29 01 00 00 00 00 02 A2 03
29 01 00 00 00 00 02 A3 76
29 01 00 00 00 00 02 A4 03
29 01 00 00 00 00 02 A5 87
29 01 00 00 00 00 02 A6 03
29 01 00 00 00 00 02 A7 9A
29 01 00 00 00 00 02 A9 03
29 01 00 00 00 00 02 AA B0
29 01 00 00 00 00 02 AB 03
29 01 00 00 00 00 02 AC D0
29 01 00 00 00 00 02 AD 03
29 01 00 00 00 00 02 AE FE
29 01 00 00 00 00 02 AF 00
29 01 00 00 00 00 02 B0 00
29 01 00 00 00 00 02 B1 00
29 01 00 00 00 00 02 B2 23
29 01 00 00 00 00 02 B3 00
29 01 00 00 00 00 02 B4 4F
29 01 00 00 00 00 02 B5 00
29 01 00 00 00 00 02 B6 6F
29 01 00 00 00 00 02 B7 00
29 01 00 00 00 00 02 B8 88
29 01 00 00 00 00 02 B9 00
29 01 00 00 00 00 02 BA 9D
29 01 00 00 00 00 02 BB 00
29 01 00 00 00 00 02 BC B0
29 01 00 00 00 00 02 BD 00
29 01 00 00 00 00 02 BE C0
29 01 00 00 00 00 02 BF 00
29 01 00 00 00 00 02 C0 D0
29 01 00 00 00 00 02 C1 01
29 01 00 00 00 00 02 C2 02
29 01 00 00 00 00 02 C3 01
29 01 00 00 00 00 02 C4 2A
29 01 00 00 00 00 02 C5 01
29 01 00 00 00 00 02 C6 69
29 01 00 00 00 00 02 C7 01
29 01 00 00 00 00 02 C8 9A
29 01 00 00 00 00 02 C9 01
29 01 00 00 00 00 02 CA E6
29 01 00 00 00 00 02 CB 02
29 01 00 00 00 00 02 CC 21
29 01 00 00 00 00 02 CD 02
29 01 00 00 00 00 02 CE 23
29 01 00 00 00 00 02 CF 02
29 01 00 00 00 00 02 D0 59
29 01 00 00 00 00 02 D1 02
29 01 00 00 00 00 02 D2 97
29 01 00 00 00 00 02 D3 02
29 01 00 00 00 00 02 D4 C0
29 01 00 00 00 00 02 D5 02
29 01 00 00 00 00 02 D6 F9
29 01 00 00 00 00 02 D7 03
29 01 00 00 00 00 02 D8 1D
29 01 00 00 00 00 02 D9 03
29 01 00 00 00 00 02 DA 4C
29 01 00 00 00 00 02 DB 03
29 01 00 00 00 00 02 DC 59
29 01 00 00 00 00 02 DD 03
29 01 00 00 00 00 02 DE 67
29 01 00 00 00 00 02 DF 03
29 01 00 00 00 00 02 E0 76
29 01 00 00 00 00 02 E1 03
29 01 00 00 00 00 02 E2 87
29 01 00 00 00 00 02 E3 03
29 01 00 00 00 00 02 E4 9A
29 01 00 00 00 00 02 E5 03
29 01 00 00 00 00 02 E6 B0
29 01 00 00 00 00 02 E7 03
29 01 00 00 00 00 02 E8 D0
29 01 00 00 00 00 02 E9 03
29 01 00 00 00 00 02 EA FE
29 01 00 00 00 00 02 FF 00
29 01 00 00 00 00 02 FB 01
29 01 00 00 00 00 02 35 01
29 01 00 00 00 00 02 D3 14
29 01 00 00 00 00 02 D4 08
29 01 00 00 00 00 02 FF 03
29 01 00 00 00 00 02 FB 01
29 01 00 00 00 00 02 1A 77
29 01 00 00 00 00 02 53 00
29 01 00 00 00 00 02 5B 00
29 01 00 00 00 00 02 63 00
29 01 00 00 00 00 02 00 00
29 01 00 00 00 00 02 01 04
29 01 00 00 00 00 02 02 08
29 01 00 00 00 00 02 03 0C
29 01 00 00 00 00 02 04 10
29 01 00 00 00 00 02 05 14
29 01 00 00 00 00 02 06 18
29 01 00 00 00 00 02 07 20
29 01 00 00 00 00 02 08 28
29 01 00 00 00 00 02 09 30
29 01 00 00 00 00 02 0A 30
29 01 00 00 00 00 02 0B 30
29 01 00 00 00 00 02 0C 30
29 01 00 00 00 00 02 0D 38
29 01 00 00 00 00 02 0E 40
29 01 00 00 00 00 02 0F 48
29 01 00 00 00 00 02 10 50
29 01 00 00 00 00 02 11 58
29 01 00 00 00 00 02 12 60
29 01 00 00 00 00 02 13 68
29 01 00 00 00 00 02 FF 00
29 01 00 00 00 00 02 FB 01
29 01 00 00 00 00 02 55 80
29 01 00 00 00 00 02 FF 05
29 01 00 00 00 00 02 FB 01
29 01 00 00 00 00 02 EA 01
29 01 00 00 00 00 02 EB 20
29 01 00 00 00 00 02 FF 00
29 01 00 00 00 00 02 FB 01
29 01 00 00 00 00 02 BA 03
			29 01 00 00 64 00 02 11 00
			29 01 00 00 78 00 02 29 00];
		qcom,mdss-dsi-off-command = [
			05 01 00 00 32 00 02 28 00
			05 01 00 00 78 00 02 10 00];
		qcom,mdss-dsi-on-command-state = "dsi_lp_mode";
		qcom,mdss-dsi-off-command-state = "dsi_hs_mode";
		qcom,mdss-dsi-h-sync-pulse = <1>;
		qcom,mdss-dsi-traffic-mode = "burst_mode";
		qcom,mdss-dsi-bllp-eof-power-mode;
		qcom,mdss-dsi-bllp-power-mode;
		qcom,mdss-dsi-lane-0-state;
		qcom,mdss-dsi-lane-1-state;
		qcom,mdss-dsi-lane-2-state;
		qcom,mdss-dsi-lane-3-state;
		qcom,mdss-dsi-panel-timings = [f9 3d 34 00 58 4d 36 3f 53 03 04 00];
		qcom,mdss-dsi-t-clk-post = <0x1e>;
		qcom,mdss-dsi-t-clk-pre = <0x38>;
		qcom,mdss-dsi-bl-min-level = <1>;
		qcom,mdss-dsi-bl-max-level = <255>;
		qcom,mdss-dsi-dma-trigger = "trigger_sw";
		qcom,mdss-dsi-mdp-trigger = "none";
		qcom,mdss-dsi-bl-pmic-control-type = "bl_ctrl_lm3630";
		qcom,mdss-dsi-reset-sequence = <1 20>, <0 200>, <1 20>;

	};
};
