/* Copyright (c) 2013-2014, The Linux Foundation. All rights reserved.
 *
 * This program is free software; you can redistribute it and/or modify
 * it under the terms of the GNU General Public License version 2 and
 * only version 2 as published by the Free Software Foundation.
 *
 * This program is distributed in the hope that it will be useful,
 * but WITHOUT ANY WARRANTY; without even the implied warranty of
 * MERCHANTABILITY or FITNESS FOR A PARTICULAR PURPOSE.  See the
 * GNU General Public License for more details.
 */

/*---------------------------------------------------------------------------
 * This file is autogenerated file using gcdb parser. Please do not edit it.
 * Update input XML file to add a new entry or update variable in this file
 * VERSION = "1.0"
 *---------------------------------------------------------------------------*/
&mdss_mdp {
	dsi_nt35695_1080p_cmd: qcom,mdss_dsi_nt35695_1080p_cmd {
		qcom,mdss-dsi-panel-name = "nt35695 1080p cmd mode dsi panel";
		qcom,mdss-dsi-panel-controller = <&mdss_dsi0>;
		qcom,mdss-dsi-panel-type = "dsi_cmd_mode";
		qcom,mdss-dsi-panel-destination = "display_1";
		qcom,mdss-dsi-panel-framerate = <60>;
		qcom,mdss-dsi-virtual-channel-id = <0>;
		qcom,mdss-dsi-stream = <0>;
		qcom,mdss-dsi-panel-width = <1080>;
		qcom,mdss-dsi-panel-height = <1920>;
		qcom,mdss-dsi-h-front-porch = <32>;
		qcom,mdss-dsi-h-back-porch = <32>;
		qcom,mdss-dsi-h-pulse-width = <8>;
		qcom,mdss-dsi-h-sync-skew = <0>;
		qcom,mdss-dsi-v-back-porch = <18>;
		qcom,mdss-dsi-v-front-porch = <2>;
		qcom,mdss-dsi-v-pulse-width = <2>;
		qcom,mdss-dsi-h-left-border = <0>;
		qcom,mdss-dsi-h-right-border = <0>;
		qcom,mdss-dsi-v-top-border = <0>;
		qcom,mdss-dsi-v-bottom-border = <0>;
		qcom,mdss-dsi-bpp = <24>;
		qcom,mdss-dsi-underflow-color = <0xff>;
		qcom,mdss-dsi-border-color = <0>;
		qcom,mdss-dsi-on-command = [
			29 01 00 00 00 00 02 FF 20
			29 01 00 00 00 00 02 FB 01
			29 01 00 00 00 00 02 00 01
			29 01 00 00 00 00 02 01 55
			29 01 00 00 00 00 02 02 45
			29 01 00 00 00 00 02 03 55
			29 01 00 00 00 00 02 05 50
			29 01 00 00 00 00 02 06 4a
			29 01 00 00 00 00 02 07 24
			29 01 00 00 00 00 02 08 0c
			29 01 00 00 00 00 02 0b 7d
			29 01 00 00 00 00 02 0c 7d
			29 01 00 00 00 00 02 0e b5
			29 01 00 00 00 00 02 0f a9
			29 01 00 00 00 00 02 11 1b
			29 01 00 00 00 00 02 14 4A
			29 01 00 00 00 00 02 15 0f
			29 01 00 00 00 00 02 16 0f
			29 01 00 00 00 00 02 18 00
			29 01 00 00 00 00 02 19 77
			29 01 00 00 00 00 02 1a 55
			29 01 00 00 00 00 02 1b 13
			29 01 00 00 00 00 02 1c 00
			29 01 00 00 00 00 02 1d 00
			29 01 00 00 00 00 02 1e 00
			29 01 00 00 00 00 02 1f 00
			29 01 00 00 00 00 02 66 00
			29 01 00 00 00 00 02 58 82
			29 01 00 00 00 00 02 59 00
			29 01 00 00 00 00 02 5A 02
			29 01 00 00 00 00 02 5B 02
			29 01 00 00 00 00 02 5C 82
			29 01 00 00 00 00 02 5D 82
			29 01 00 00 00 00 02 5E 02
			29 01 00 00 00 00 02 5F 00
			29 01 00 00 00 00 02 30 01
			29 01 00 00 00 00 02 72 31
			29 01 00 00 00 00 02 6d 55
			29 01 00 00 00 00 02 FF 20
			29 01 00 00 00 00 02 FB 01
			29 01 00 00 00 00 02 75 00
			29 01 00 00 00 00 02 76 19
			29 01 00 00 00 00 02 77 00
			29 01 00 00 00 00 02 78 37
			29 01 00 00 00 00 02 79 00
			29 01 00 00 00 00 02 7A 5C
			29 01 00 00 00 00 02 7B 00
			29 01 00 00 00 00 02 7C 79
			29 01 00 00 00 00 02 7D 00
			29 01 00 00 00 00 02 7E 91
			29 01 00 00 00 00 02 7F 00
			29 01 00 00 00 00 02 80 A4
			29 01 00 00 00 00 02 81 00
			29 01 00 00 00 00 02 82 B6
			29 01 00 00 00 00 02 83 00
			29 01 00 00 00 00 02 84 C7
			29 01 00 00 00 00 02 85 00
			29 01 00 00 00 00 02 86 D5
			29 01 00 00 00 00 02 87 01
			29 01 00 00 00 00 02 88 04
			29 01 00 00 00 00 02 89 01
			29 01 00 00 00 00 02 8A 2A
			29 01 00 00 00 00 02 8B 01
			29 01 00 00 00 00 02 8C 67
			29 01 00 00 00 00 02 8D 01
			29 01 00 00 00 00 02 8E 96
			29 01 00 00 00 00 02 8F 01
			29 01 00 00 00 00 02 90 E1
			29 01 00 00 00 00 02 91 02
			29 01 00 00 00 00 02 92 1B
			29 01 00 00 00 00 02 93 02
			29 01 00 00 00 00 02 94 1C
			29 01 00 00 00 00 02 95 02
			29 01 00 00 00 00 02 96 51
			29 01 00 00 00 00 02 97 02
			29 01 00 00 00 00 02 98 8B
			29 01 00 00 00 00 02 99 02
			29 01 00 00 00 00 02 9A B1
			29 01 00 00 00 00 02 9B 02
			29 01 00 00 00 00 02 9C E5
			29 01 00 00 00 00 02 9D 03
			29 01 00 00 00 00 02 9E 08
			29 01 00 00 00 00 02 9F 03
			29 01 00 00 00 00 02 A0 35
			29 01 00 00 00 00 02 A2 03
			29 01 00 00 00 00 02 A3 43
			29 01 00 00 00 00 02 A4 03
			29 01 00 00 00 00 02 A5 51
			29 01 00 00 00 00 02 A6 03
			29 01 00 00 00 00 02 A7 61
			29 01 00 00 00 00 02 A9 03
			29 01 00 00 00 00 02 AA 73
			29 01 00 00 00 00 02 AB 03
			29 01 00 00 00 00 02 AC 87
			29 01 00 00 00 00 02 AD 03
			29 01 00 00 00 00 02 AE 9D
			29 01 00 00 00 00 02 AF 03
			29 01 00 00 00 00 02 B0 B1
			29 01 00 00 00 00 02 B1 03
			29 01 00 00 00 00 02 B2 B5
			29 01 00 00 00 00 02 B3 00
			29 01 00 00 00 00 02 B4 19
			29 01 00 00 00 00 02 B5 00
			29 01 00 00 00 00 02 B6 37
			29 01 00 00 00 00 02 B7 00
			29 01 00 00 00 00 02 B8 5C
			29 01 00 00 00 00 02 B9 00
			29 01 00 00 00 00 02 BA 79
			29 01 00 00 00 00 02 BB 00
			29 01 00 00 00 00 02 BC 91
			29 01 00 00 00 00 02 BD 00
			29 01 00 00 00 00 02 BE A4
			29 01 00 00 00 00 02 BF 00
			29 01 00 00 00 00 02 C0 B6
			29 01 00 00 00 00 02 C1 00
			29 01 00 00 00 00 02 C2 C7
			29 01 00 00 00 00 02 C3 00
			29 01 00 00 00 00 02 C4 D5
			29 01 00 00 00 00 02 C5 01
			29 01 00 00 00 00 02 C6 04
			29 01 00 00 00 00 02 C7 01
			29 01 00 00 00 00 02 C8 2A
			29 01 00 00 00 00 02 C9 01
			29 01 00 00 00 00 02 CA 67
			29 01 00 00 00 00 02 CB 01
			29 01 00 00 00 00 02 CC 96
			29 01 00 00 00 00 02 CD 01
			29 01 00 00 00 00 02 CE E1
			29 01 00 00 00 00 02 CF 02
			29 01 00 00 00 00 02 D0 1B
			29 01 00 00 00 00 02 D1 02
			29 01 00 00 00 00 02 D2 1C
			29 01 00 00 00 00 02 D3 02
			29 01 00 00 00 00 02 D4 51
			29 01 00 00 00 00 02 D5 02
			29 01 00 00 00 00 02 D6 8B
			29 01 00 00 00 00 02 D7 02
			29 01 00 00 00 00 02 D8 B1
			29 01 00 00 00 00 02 D9 02
			29 01 00 00 00 00 02 DA E5
			29 01 00 00 00 00 02 DB 03
			29 01 00 00 00 00 02 DC 08
			29 01 00 00 00 00 02 DD 03
			29 01 00 00 00 00 02 DE 35
			29 01 00 00 00 00 02 DF 03
			29 01 00 00 00 00 02 E0 43
			29 01 00 00 00 00 02 E1 03
			29 01 00 00 00 00 02 E2 51
			29 01 00 00 00 00 02 E3 03
			29 01 00 00 00 00 02 E4 61
			29 01 00 00 00 00 02 E5 03
			29 01 00 00 00 00 02 E6 73
			29 01 00 00 00 00 02 E7 03
			29 01 00 00 00 00 02 E8 87
			29 01 00 00 00 00 02 E9 03
			29 01 00 00 00 00 02 EA 9D
			29 01 00 00 00 00 02 EB 03
			29 01 00 00 00 00 02 EC B1
			29 01 00 00 00 00 02 ED 03
			29 01 00 00 00 00 02 EE B5
			29 01 00 00 00 00 02 EF 00
			29 01 00 00 00 00 02 F0 19
			29 01 00 00 00 00 02 F1 00
			29 01 00 00 00 00 02 F2 37
			29 01 00 00 00 00 02 F3 00
			29 01 00 00 00 00 02 F4 5C
			29 01 00 00 00 00 02 F5 00
			29 01 00 00 00 00 02 F6 79
			29 01 00 00 00 00 02 F7 00
			29 01 00 00 00 00 02 F8 91
			29 01 00 00 00 00 02 F9 00
			29 01 00 00 00 00 02 FA A4
			29 01 00 00 00 00 02 FF 21
			29 01 00 00 00 00 02 FB 01
			29 01 00 00 00 00 02 00 00
			29 01 00 00 00 00 02 01 B6
			29 01 00 00 00 00 02 02 00
			29 01 00 00 00 00 02 03 C7
			29 01 00 00 00 00 02 04 00
			29 01 00 00 00 00 02 05 D5
			29 01 00 00 00 00 02 06 01
			29 01 00 00 00 00 02 07 04
			29 01 00 00 00 00 02 08 01
			29 01 00 00 00 00 02 09 2A
			29 01 00 00 00 00 02 0a 01
			29 01 00 00 00 00 02 0b 67
			29 01 00 00 00 00 02 0c 01
			29 01 00 00 00 00 02 0d 96
			29 01 00 00 00 00 02 0e 01
			29 01 00 00 00 00 02 0f E1
			29 01 00 00 00 00 02 10 02
			29 01 00 00 00 00 02 11 1B
			29 01 00 00 00 00 02 12 02
			29 01 00 00 00 00 02 13 1C
			29 01 00 00 00 00 02 14 02
			29 01 00 00 00 00 02 15 51
			29 01 00 00 00 00 02 16 02
			29 01 00 00 00 00 02 17 8B
			29 01 00 00 00 00 02 18 02
			29 01 00 00 00 00 02 19 B1
			29 01 00 00 00 00 02 1a 02
			29 01 00 00 00 00 02 1b E5
			29 01 00 00 00 00 02 1c 03
			29 01 00 00 00 00 02 1d 08
			29 01 00 00 00 00 02 1e 03
			29 01 00 00 00 00 02 1f 35
			29 01 00 00 00 00 02 20 03
			29 01 00 00 00 00 02 21 43
			29 01 00 00 00 00 02 22 03
			29 01 00 00 00 00 02 23 51
			29 01 00 00 00 00 02 24 03
			29 01 00 00 00 00 02 25 61
			29 01 00 00 00 00 02 26 03
			29 01 00 00 00 00 02 27 73
			29 01 00 00 00 00 02 28 03
			29 01 00 00 00 00 02 29 87
			29 01 00 00 00 00 02 2a 03
			29 01 00 00 00 00 02 2b 9D
			29 01 00 00 00 00 02 2d 03
			29 01 00 00 00 00 02 2f B1
			29 01 00 00 00 00 02 30 03
			29 01 00 00 00 00 02 31 B5
			29 01 00 00 00 00 02 32 00
			29 01 00 00 00 00 02 33 19
			29 01 00 00 00 00 02 34 00
			29 01 00 00 00 00 02 35 37
			29 01 00 00 00 00 02 36 00
			29 01 00 00 00 00 02 37 5C
			29 01 00 00 00 00 02 38 00
			29 01 00 00 00 00 02 39 79
			29 01 00 00 00 00 02 3a 00
			29 01 00 00 00 00 02 3b 91
			29 01 00 00 00 00 02 3d 00
			29 01 00 00 00 00 02 3f A4
			29 01 00 00 00 00 02 40 00
			29 01 00 00 00 00 02 41 B6
			29 01 00 00 00 00 02 42 00
			29 01 00 00 00 00 02 43 C7
			29 01 00 00 00 00 02 44 00
			29 01 00 00 00 00 02 45 D5
			29 01 00 00 00 00 02 46 01
			29 01 00 00 00 00 02 47 04
			29 01 00 00 00 00 02 48 01
			29 01 00 00 00 00 02 49 2A
			29 01 00 00 00 00 02 4a 01
			29 01 00 00 00 00 02 4b 67
			29 01 00 00 00 00 02 4c 01
			29 01 00 00 00 00 02 4d 96
			29 01 00 00 00 00 02 4e 01
			29 01 00 00 00 00 02 4f E1
			29 01 00 00 00 00 02 50 02
			29 01 00 00 00 00 02 51 1B
			29 01 00 00 00 00 02 52 02
			29 01 00 00 00 00 02 53 1C
			29 01 00 00 00 00 02 54 02
			29 01 00 00 00 00 02 55 51
			29 01 00 00 00 00 02 56 02
			29 01 00 00 00 00 02 58 8B
			29 01 00 00 00 00 02 59 02
			29 01 00 00 00 00 02 5a B1
			29 01 00 00 00 00 02 5b 02
			29 01 00 00 00 00 02 5c E5
			29 01 00 00 00 00 02 5d 03
			29 01 00 00 00 00 02 5e 08
			29 01 00 00 00 00 02 5f 03
			29 01 00 00 00 00 02 60 35
			29 01 00 00 00 00 02 61 03
			29 01 00 00 00 00 02 62 43
			29 01 00 00 00 00 02 63 03
			29 01 00 00 00 00 02 64 51
			29 01 00 00 00 00 02 65 03
			29 01 00 00 00 00 02 66 61
			29 01 00 00 00 00 02 67 03
			29 01 00 00 00 00 02 68 73
			29 01 00 00 00 00 02 69 03
			29 01 00 00 00 00 02 6a 87
			29 01 00 00 00 00 02 6b 03
			29 01 00 00 00 00 02 6c 9D
			29 01 00 00 00 00 02 6d 03
			29 01 00 00 00 00 02 6e B1
			29 01 00 00 00 00 02 6f 03
			29 01 00 00 00 00 02 70 B5
			29 01 00 00 00 00 02 71 00
			29 01 00 00 00 00 02 72 19
			29 01 00 00 00 00 02 73 00
			29 01 00 00 00 00 02 74 37
			29 01 00 00 00 00 02 75 00
			29 01 00 00 00 00 02 76 5C
			29 01 00 00 00 00 02 77 00
			29 01 00 00 00 00 02 78 79
			29 01 00 00 00 00 02 79 00
			29 01 00 00 00 00 02 7a 91
			29 01 00 00 00 00 02 7b 00
			29 01 00 00 00 00 02 7c A4
			29 01 00 00 00 00 02 7d 00
			29 01 00 00 00 00 02 7e B6
			29 01 00 00 00 00 02 7f 00
			29 01 00 00 00 00 02 80 C7
			29 01 00 00 00 00 02 81 00
			29 01 00 00 00 00 02 82 D5
			29 01 00 00 00 00 02 83 01
			29 01 00 00 00 00 02 84 04
			29 01 00 00 00 00 02 85 01
			29 01 00 00 00 00 02 86 2A
			29 01 00 00 00 00 02 87 01
			29 01 00 00 00 00 02 88 67
			29 01 00 00 00 00 02 89 01
			29 01 00 00 00 00 02 8a 96
			29 01 00 00 00 00 02 8b 01
			29 01 00 00 00 00 02 8c E1
			29 01 00 00 00 00 02 8d 02
			29 01 00 00 00 00 02 8e 1B
			29 01 00 00 00 00 02 8f 02
			29 01 00 00 00 00 02 90 1C
			29 01 00 00 00 00 02 91 02
			29 01 00 00 00 00 02 92 51
			29 01 00 00 00 00 02 93 02
			29 01 00 00 00 00 02 94 8B
			29 01 00 00 00 00 02 95 02
			29 01 00 00 00 00 02 96 B1
			29 01 00 00 00 00 02 97 02
			29 01 00 00 00 00 02 98 E5
			29 01 00 00 00 00 02 99 03
			29 01 00 00 00 00 02 9a 08
			29 01 00 00 00 00 02 9b 03
			29 01 00 00 00 00 02 9c 35
			29 01 00 00 00 00 02 9d 03
			29 01 00 00 00 00 02 9e 43
			29 01 00 00 00 00 02 9f 03
			29 01 00 00 00 00 02 a0 51
			29 01 00 00 00 00 02 a2 03
			29 01 00 00 00 00 02 a3 61
			29 01 00 00 00 00 02 a4 03
			29 01 00 00 00 00 02 a5 73
			29 01 00 00 00 00 02 a6 03
			29 01 00 00 00 00 02 a7 87
			29 01 00 00 00 00 02 a9 03
			29 01 00 00 00 00 02 aa 9D
			29 01 00 00 00 00 02 ab 03
			29 01 00 00 00 00 02 ac B1
			29 01 00 00 00 00 02 ad 03
			29 01 00 00 00 00 02 ae B5
			29 01 00 00 00 00 02 af 00
			29 01 00 00 00 00 02 b0 19
			29 01 00 00 00 00 02 b1 00
			29 01 00 00 00 00 02 b2 37
			29 01 00 00 00 00 02 b3 00
			29 01 00 00 00 00 02 b4 5C
			29 01 00 00 00 00 02 b5 00
			29 01 00 00 00 00 02 b6 79
			29 01 00 00 00 00 02 b7 00
			29 01 00 00 00 00 02 b8 91
			29 01 00 00 00 00 02 b9 00
			29 01 00 00 00 00 02 ba A4
			29 01 00 00 00 00 02 bb 00
			29 01 00 00 00 00 02 bc B6
			29 01 00 00 00 00 02 bd 00
			29 01 00 00 00 00 02 be C7
			29 01 00 00 00 00 02 bf 00
			29 01 00 00 00 00 02 c0 D5
			29 01 00 00 00 00 02 c1 01
			29 01 00 00 00 00 02 c2 04
			29 01 00 00 00 00 02 c3 01
			29 01 00 00 00 00 02 c4 2A
			29 01 00 00 00 00 02 c5 01
			29 01 00 00 00 00 02 c6 67
			29 01 00 00 00 00 02 c7 01
			29 01 00 00 00 00 02 c8 96
			29 01 00 00 00 00 02 c9 01
			29 01 00 00 00 00 02 ca E1
			29 01 00 00 00 00 02 cb 02
			29 01 00 00 00 00 02 cc 1B
			29 01 00 00 00 00 02 cd 02
			29 01 00 00 00 00 02 ce 1C
			29 01 00 00 00 00 02 cf 02
			29 01 00 00 00 00 02 d0 51
			29 01 00 00 00 00 02 d1 02
			29 01 00 00 00 00 02 d2 8B
			29 01 00 00 00 00 02 d3 02
			29 01 00 00 00 00 02 d4 B1
			29 01 00 00 00 00 02 d5 02
			29 01 00 00 00 00 02 d6 E5
			29 01 00 00 00 00 02 d7 03
			29 01 00 00 00 00 02 d8 08
			29 01 00 00 00 00 02 d9 03
			29 01 00 00 00 00 02 da 35
			29 01 00 00 00 00 02 db 03
			29 01 00 00 00 00 02 dc 43
			29 01 00 00 00 00 02 dd 03
			29 01 00 00 00 00 02 de 51
			29 01 00 00 00 00 02 df 03
			29 01 00 00 00 00 02 e0 61
			29 01 00 00 00 00 02 e1 03
			29 01 00 00 00 00 02 e2 73
			29 01 00 00 00 00 02 e3 03
			29 01 00 00 00 00 02 e4 87
			29 01 00 00 00 00 02 e5 03
			29 01 00 00 00 00 02 e6 9D
			29 01 00 00 00 00 02 e7 03
			29 01 00 00 00 00 02 e8 B1
			29 01 00 00 00 00 02 e9 03
			29 01 00 00 00 00 02 ea B5
			29 01 00 00 00 00 02 ff 24
			29 01 00 00 00 00 02 fb 01
			29 01 00 00 00 00 02 00 01
			29 01 00 00 00 00 02 01 0b
			29 01 00 00 00 00 02 02 0c
			29 01 00 00 00 00 02 03 09
			29 01 00 00 00 00 02 04 0a
			29 01 00 00 00 00 02 05 00
			29 01 00 00 00 00 02 06 0f
			29 01 00 00 00 00 02 07 10
			29 01 00 00 00 00 02 08 00
			29 01 00 00 00 00 02 09 00
			29 01 00 00 00 00 02 0a 00
			29 01 00 00 00 00 02 0b 00
			29 01 00 00 00 00 02 0c 00
			29 01 00 00 00 00 02 0d 13
			29 01 00 00 00 00 02 0e 15
			29 01 00 00 00 00 02 0f 17
			29 01 00 00 00 00 02 10 01
			29 01 00 00 00 00 02 11 2b
			29 01 00 00 00 00 02 12 0c
			29 01 00 00 00 00 02 13 09
			29 01 00 00 00 00 02 14 0a
			29 01 00 00 00 00 02 15 00
			29 01 00 00 00 00 02 16 0f
			29 01 00 00 00 00 02 17 10
			29 01 00 00 00 00 02 18 00
			29 01 00 00 00 00 02 19 00
			29 01 00 00 00 00 02 1a 00
			29 01 00 00 00 00 02 1b 00
			29 01 00 00 00 00 02 1c 00
			29 01 00 00 00 00 02 1d 13
			29 01 00 00 00 00 02 1e 15
			29 01 00 00 00 00 02 1f 17
			29 01 00 00 00 00 02 20 00
			29 01 00 00 00 00 02 21 03
			29 01 00 00 00 00 02 22 01
			29 01 00 00 00 00 02 23 40
			29 01 00 00 00 00 02 24 40
			29 01 00 00 00 00 02 25 6d
			29 01 00 00 00 00 02 26 40
			29 01 00 00 00 00 02 27 40
			29 01 00 00 00 00 02 29 58
			29 01 00 00 00 00 02 2a 12
			29 01 00 00 00 00 02 4b 06
			29 01 00 00 00 00 02 4c 11
			29 01 00 00 00 00 02 4d 20
			29 01 00 00 00 00 02 4e 02
			29 01 00 00 00 00 02 4f 02
			29 01 00 00 00 00 02 50 20
			29 01 00 00 00 00 02 51 61
			29 01 00 00 00 00 02 52 01
			29 01 00 00 00 00 02 53 78
			29 01 00 00 00 00 02 56 78
			29 01 00 00 00 00 02 54 86
			29 01 00 00 00 00 02 58 86
			29 01 00 00 00 00 02 55 6d
			29 01 00 00 00 00 02 5b 00
			29 01 00 00 00 00 02 5c 00
			29 01 00 00 00 00 02 5f 15
			29 01 00 00 00 00 02 60 75
			29 01 00 00 00 00 02 63 00
			29 01 00 00 00 00 02 64 00
			29 01 00 00 00 00 02 67 00
			29 01 00 00 00 00 02 68 04
			29 01 00 00 00 00 02 7a 80
			29 01 00 00 00 00 02 7b a3
			29 01 00 00 00 00 02 7c d8
			29 01 00 00 00 00 02 7d 60
			29 01 00 00 00 00 02 7f 1a
			29 01 00 00 00 00 02 75 1a
			29 01 00 00 00 00 02 b3 aa
			29 01 00 00 00 00 02 b4 01
			29 01 00 00 00 00 02 b5 40
			29 01 00 00 00 00 02 78 00
			29 01 00 00 00 00 02 79 00
			29 01 00 00 00 00 02 80 00
			29 01 00 00 00 00 02 83 00
			29 01 00 00 00 00 02 93 06
			29 01 00 00 00 00 02 94 08
			29 01 00 00 00 00 02 8a 00
			29 01 00 00 00 00 02 9b 0f
			29 01 00 00 00 00 02 c5 3a
			29 01 00 00 00 00 02 c6 09
			29 01 00 00 00 00 02 ff 23
			29 01 00 00 00 00 02 fb 01
			29 01 00 00 00 00 02 08 0f
			29 01 00 00 00 00 02 ff 10
			29 01 00 00 00 00 02 ff 24
			29 01 00 00 00 00 02 fb 01
			29 01 00 00 00 00 02 c6 00
			29 01 00 00 00 00 02 92 94
			29 01 00 00 00 00 02 c5 32
			29 01 00 00 00 00 02 ff 10
			29 01 00 00 00 00 02 51 FF
			29 01 00 00 00 00 02 53 2C
			29 01 00 00 00 00 02 55 01
			29 01 00 00 00 00 02 35 00
			39 01 00 00 00 00 03 44 04 ff
			39 01 00 00 00 00 04 3b 03 08 06
			29 01 00 00 00 00 02 bb 10
			05 01 00 00 00 00 01 11
			05 01 00 00 00 00 01 29];
		qcom,mdss-dsi-off-command = [
			05 01 00 00 00 00 01 28
			05 01 00 00 00 00 01 10];
		qcom,mdss-dsi-on-command-state = "dsi_lp_mode";
		qcom,mdss-dsi-off-command-state = "dsi_hs_mode";
		qcom,mdss-dsi-h-sync-pulse = <1>;
		qcom,mdss-dsi-traffic-mode = "burst_mode";
		qcom,mdss-dsi-bllp-eof-power-mode;
		qcom,mdss-dsi-bllp-power-mode;
		qcom,mdss-dsi-lane-0-state;
		qcom,mdss-dsi-lane-1-state;
		qcom,mdss-dsi-lane-2-state;
		qcom,mdss-dsi-lane-3-state;
		qcom,mdss-dsi-te-pin-select = <1>;
		qcom,mdss-dsi-wr-mem-start = <0x2c>;
		qcom,mdss-dsi-te-dcs-command = <1>;
		qcom,mdss-dsi-te-check-enable;
		qcom,mdss-dsi-te-using-te-pin;
		qcom,mdss-dsi-panel-timings = [f9 3d 34 00 58 4d 36 3f 53 03 04 00];
		qcom,mdss-dsi-t-clk-post = <0x1e>;
		qcom,mdss-dsi-t-clk-pre = <0x38>;
		qcom,mdss-dsi-bl-min-level = <1>;
		qcom,mdss-dsi-bl-max-level = <255>;
		qcom,mdss-dsi-dma-trigger = "trigger_sw";
		qcom,mdss-dsi-mdp-trigger = "none";
		qcom,mdss-dsi-bl-pmic-control-type = "bl_ctrl_lm3630";
		qcom,mdss-dsi-reset-sequence = <1 20>, <0 200>, <1 20>;
	};
};
