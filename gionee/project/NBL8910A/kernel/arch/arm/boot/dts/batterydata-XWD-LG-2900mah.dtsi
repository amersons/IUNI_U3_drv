/* Copyright (c) 2013, The Linux Foundation. All rights reserved.
 *
 * This program is free software; you can redistribute it and/or modify
 * it under the terms of the GNU General Public License version 2 and
 * only version 2 as published by the Free Software Foundation.
 *
 * This program is distributed in the hope that it will be useful,
 * but WITHOUT ANY WARRANTY; without even the implied warranty of
 * MERCHANTABILITY or FITNESS FOR A PARTICULAR PURPOSE.  See the
 * GNU General Public License for more details.
 */

qcom,lg-xwd-2900mah {
	qcom,fcc-mah = <2900>;
	qcom,default-rbatt-mohm = <121>;
	qcom,rbatt-capacitive-mohm = <50>;
	qcom,flat-ocv-threshold-uv = <3700000>;
	qcom,max-voltage-uv = <4350000>;
	qcom,v-cutoff-uv = <3400000>;
	qcom,chg-term-ua = <100000>;
	qcom,batt-id-kohm = <47>;

	qcom,fcc-temp-lut {
		qcom,lut-col-legend = <(-20) 0 25 40 60>;
		qcom,lut-data = <2955 2963 2966 2950 2930>;
	};

	qcom,pc-temp-ocv-lut {
		qcom,lut-col-legend = <(-20) 0 25 40 60>;
		qcom,lut-row-legend = <100 95 90 85 80>,
				<75 70 65 60 55>,
				<50 45 40 35 30>,
				<25 20 16 13 11>,
				<10 9 8 7 6>,
				<5 4 3 2 1>,
				<0>;
		qcom,lut-data = <4340 4339 4334 4331 4323>,
				<4243 4269 4268 4265 4259>,
				<4173 4209 4210 4208 4202>,
				<4104 4152 4154 4153 4147>,
				<4061 4099 4101 4100 4094>,
				<3989 4048 4051 4050 4045>,
				<3935 3992 4002 4004 4000>,
				<3893 3941 3961 3962 3959>,
				<3852 3899 3918 3923 3920>,
				<3821 3862 3871 3878 3874>,
				<3802 3831 3839 3839 3838>,
				<3787 3806 3815 3816 3814>,
				<3773 3787 3795 3796 3794>,
				<3759 3775 3779 3779 3777>,
				<3744 3764 3766 3762 3757>,
				<3728 3749 3753 3743 3730>,
				<3710 3726 3729 3719 3706>,
				<3691 3703 3698 3689 3676>,
				<3673 3687 3680 3670 3659>,
				<3661 3679 3676 3667 3655>,
				<3651 3674 3673 3665 3653>,
				<3642 3669 3670 3662 3651>,
				<3630 3664 3666 3659 3647>,
				<3616 3654 3659 3652 3638>,
				<3596 3638 3640 3632 3612>,
				<3572 3609 3600 3594 3571>,
				<3537 3567 3546 3543 3519>,
				<3489 3508 3478 3479 3453>,
				<3416 3424 3387 3391 3362>,
				<3301 3288 3248 3260 3228>,
				<3000 3000 3000 3000 3000>;
	};

	qcom,rbatt-sf-lut {
		qcom,lut-col-legend = <(-20) 0 25 40 60>;
		qcom,lut-row-legend = <100 95 90 85 80>,
				<75 70 65 60 55>,
				<50 45 40 35 30>,
				<25 20 16 13 11>,
				<10 9 8 7 6>,
				<5 4 3 2 1>,
				<0>;
/*
		qcom,lut-data = <1191 242 100 71 64>,
				<1190 242 100 71 64>,
				<1142 248 105 75 66>,
				<1089 257 112 78 67>,
				<1098 264 120 81 70>,
				<1040 283 128 85 72>,                             
				<1018 274 134 90 76>,                             
				<1023 253 142 94 79>,                             
				<1028 250 138 98 82>,                             
				<1047 245 113 90 76>,                             
				<1095 246 108 76 66>,                             
				<1159 250 111 78 69>,                             
				<1239 257 116 83 74>,                             
				<1330 276 120 87 76>,                             
				<1422 307 123 84 75>,                             
				<1514 347 127 80 69>,                             
				<1609 390 126 79 69>,                             
				<1688 429 121 79 68>,                             
				<1726 466 121 80 68>,                             
				<1690 483 131 83 71>,                             
				<1743 502 138 85 72>,                             
				<1837 526 145 88 74>,                             
				<1976 554 152 91 76>,                             
				<2175 582 160 92 74>,                             
				<2435 617 157 89 71>,                             
				<2795 646 152 87 74>,                             
				<3300 685 160 92 77>,                             
				<4054 738 176 99 81>,                             
				<5170 816 204 107 88>,                             
				<7275 1085 357 135 124>,                             
				<12258 2474 1685 3839 660>;
*/

		qcom,lut-data = <484 242 100 71 64>,
				<484 242 100 71 64>,
				<496 248 105 75 66>,
				<514 257 112 78 67>,
				<528 264 120 81 70>,
				<566 283 128 85 72>,                             
				<548 274 134 90 76>,                             
				<506 253 142 94 79>,                             
				<500 250 138 98 82>,                             
				<490 245 113 90 76>,                             
				<492 246 108 76 66>,                             
				<500 250 111 78 69>,                             
				<514 257 116 83 74>,                             
				<552 276 120 87 76>,                             
				<614 307 123 84 75>,                             
				<694 347 127 80 69>,                             
				<780 390 126 79 69>,                             
				<858 429 121 79 68>,                             
				<932 466 121 80 68>,                             
				<966 483 131 83 71>,                             
				<1004 502 138 85 72>,                             
				<1052 526 145 88 74>,                             
				<1108 554 152 91 76>,                             
				<1164 582 160 92 74>,                             
				<1234 617 157 89 71>,                             
				<1292 646 152 87 74>,                             
				<1370 685 160 92 77>,                             
				<1476 738 176 99 81>,                             
				<1632 816 204 107 88>,                             
				<2170 1085 357 135 124>,                             
				<4248 2474 1685 3839 660>;
	};
};
